## board/mestek/trailmark-green/Kconfig
```kconfig
if TARGET_AM335X_TRAILMARK_GREEN

config SYS_BOARD
	default "Trailmark Green"

config SYS_VENDOR
	default "Mestek Inc"

config SYS_SOC
	default "am33xx"

config SYS_CONFIG_NAME
	default "trailmark_green"

config TRAILMARK_GREEN_FIXUP_ETH_PHYADDR
	bool "Fixup the Ethernet PHY address in Linux DTB"
	default y
	select OF_BOARD_SETUP
	select OF_CONTROL
	select DM_ETH
	select DRIVER_TI_CPSW

endif
```

## board/mestek/trailmark_green/Kconfig
```kconfig
if TARGET_MESTEK_TRAILMARK_GREEN

config SYS_BOARD
	default "trailmark_green"

config SYS_VENDOR
	default "mestek"

config SYS_SOC
	default "am33xx"

config SYS_CONFIG_NAME
	default "trailmark_green"

#config TRAILMARK_GREEN_FIXUP_ETH_PHYADDR
#	bool "Fixup the Ethernet PHY address in Linux DTB"
#	default y
#	select OF_BOARD_SETUP
#	select OF_CONTROL
#	select DM_ETH
#	select DRIVER_TI_CPSW

endif
```

## configs/trailmark_defconfig
```kconfig
CONFIG_ARM=y
CONFIG_ARCH_CPU_INIT=y
CONFIG_ARCH_OMAP2PLUS=y
CONFIG_SPL_GPIO_SUPPORT=y
CONFIG_SPL_LIBCOMMON_SUPPORT=y
CONFIG_SPL_LIBGENERIC_SUPPORT=y
CONFIG_DM_GPIO=y
CONFIG_DEFAULT_DEVICE_TREE="am335x-trailmark-green"
CONFIG_AM33XX=y
CONFIG_TARGET_MESTEK_TRAILMARK_GREEN=y
CONFIG_SPL_MMC_SUPPORT=y
CONFIG_SPL_SERIAL_SUPPORT=y
CONFIG_SPL=y
CONFIG_SPL_FS_FAT=y
CONFIG_SPL_LIBDISK_SUPPORT=y
CONFIG_LTO=y
CONFIG_ENV_VARS_UBOOT_CONFIG=y
# CONFIG_EXPERT is not set
# CONFIG_FIT is not set
CONFIG_OF_BOARD_SETUP=y
CONFIG_LOGLEVEL=3
# CONFIG_CONSOLE_MUX is not set
CONFIG_SYS_CONSOLE_INFO_QUIET=y
# CONFIG_SYS_DEVICE_NULLDEV is not set
CONFIG_ARCH_MISC_INIT=y
# CONFIG_SPL_RAW_IMAGE_SUPPORT is not set
CONFIG_SPL_SYS_MALLOC_SIMPLE=y
CONFIG_SPL_SEPARATE_BSS=y
# CONFIG_SYS_MMCSD_RAW_MODE_U_BOOT_USE_SECTOR is not set
# CONFIG_SPL_CRC32_SUPPORT is not set
CONFIG_SPL_ENV_SUPPORT=y
# CONFIG_SPL_NAND_SUPPORT is not set
CONFIG_SPL_POWER_SUPPORT=y
CONFIG_SPL_WATCHDOG_SUPPORT=y
CONFIG_HUSH_PARSER=y
CONFIG_SYS_PROMPT="uboot =>"
# CONFIG_SYS_XTRACE is not set
# CONFIG_CMD_BDI is not set
# CONFIG_CMD_CONSOLE is not set
# CONFIG_CMD_BOOTD is not set
# CONFIG_CMD_BOOTM is not set
CONFIG_CMD_BOOTZ=y
# CONFIG_CMD_ELF is not set
# CONFIG_CMD_FDT is not set
# CONFIG_CMD_GO is not set
# CONFIG_CMD_IMI is not set
# CONFIG_CMD_XIMG is not set
CONFIG_CMD_ASKENV=y
# CONFIG_CMD_CRC32 is not set
# CONFIG_CMD_MEMORY is not set
# CONFIG_CMD_LOADB is not set
# CONFIG_CMD_LOADS is not set
CONFIG_CMD_MMC=y
CONFIG_CMD_PART=y
# CONFIG_CMD_SETEXPR is not set
# CONFIG_CMD_NET is not set
# CONFIG_CMD_BLOCK_CACHE is not set
# CONFIG_CMD_SLEEP is not set
CONFIG_CMD_EXT2=y
CONFIG_CMD_EXT4=y
CONFIG_CMD_FAT=y
CONFIG_CMD_FS_GENERIC=y
CONFIG_EFI_PARTITION=y
# CONFIG_SPL_EFI_PARTITION is not set
CONFIG_OF_CONTROL=y
CONFIG_SYS_RELOC_GD_ENV_ADDR=y
CONFIG_USE_DEFAULT_ENV_FILE=y
CONFIG_DEFAULT_ENV_FILE="board/mestek/trailmark_green/bootenv"
CONFIG_BOOTP_SEND_HOSTNAME=y
CONFIG_DM=y
CONFIG_SPL_DM=y
# CONFIG_DM_DEVICE_REMOVE is not set
# CONFIG_DM_STDIO is not set
CONFIG_SPL_DM_SEQ_ALIAS=y
CONFIG_REGMAP=y
CONFIG_SPL_REGMAP=y
CONFIG_SYSCON=y
CONFIG_SIMPLE_BUS_CORRECT_RANGE=y
CONFIG_CLK=y
CONFIG_CLK_CCF=y
CONFIG_CLK_TI_AM3_DPLL=y
CONFIG_CLK_TI_CTRL=y
CONFIG_CLK_TI_DIVIDER=y
CONFIG_CLK_TI_GATE=y
CONFIG_CLK_TI_MUX=y
# CONFIG_SPL_DM_GPIO is not set
CONFIG_DM_I2C=y
# CONFIG_INPUT is not set
# CONFIG_MMC_WRITE is not set
# CONFIG_MMC_HW_PARTITIONING is not set
CONFIG_MMC_OMAP_HS=y
CONFIG_DM_ETH=y
CONFIG_DRIVER_TI_CPSW=y
CONFIG_PINCTRL=y
CONFIG_SPL_PINCTRL=y
CONFIG_DM_SERIAL=y
CONFIG_DM_VIDEO=y
CONFIG_VIDEO_PCI_DEFAULT_FB_SIZE=0x10F0000
CONFIG_BACKLIGHT_GPIO=y
# CONFIG_CMD_VIDCONSOLE is not set
# CONFIG_VIDEO_BPP8 is not set
# CONFIG_VIDEO_BPP32 is not set
# CONFIG_VIDEO_ANSI is not set
# CONFIG_CONSOLE_NORMAL is not set
CONFIG_AM335X_LCD=y
CONFIG_SPLASH_SCREEN=y
CONFIG_SPLASH_SOURCE=y
CONFIG_BMP_16BPP=y
# CONFIG_WATCHDOG_AUTOSTART is not set
CONFIG_WDT=y
# CONFIG_SPL_WDT is not set
CONFIG_EXT4_WRITE=y
CONFIG_FAT_WRITE=y
# CONFIG_REGEX is not set
# CONFIG_GZIP is not set
CONFIG_SPL_OF_LIBFDT=y
# CONFIG_EFI_LOADER is not set
```
