/*
 * Copyright (C) 2012 Texas Instruments Incorporated - http://www.ti.com/
 *
 * This program is free software; you can redistribute it and/or modify
 * it under the terms of the GNU General Public License version 2 as
 * published by the Free Software Foundation.
 */
/dts-v1/;

#include "am33xx.dtsi"
#include "am335x-trailmark-green.dtsi"

/ {
	model = "Trailmark Green";
	compatible = "mestek,trailmark-green", "ti,am33xx";
	chosen {
		stdout-path = &uart0;
	};
};
